## Kconfig
```kconfig
config ANALOG_INPUT
    bool "Analog Input Driver"
    depends on ADC
    default y
    help
      Driver for analog input devices such as thumbsticks.

config ANALOG_INPUT_SCAN_MODE
    bool "Enable ADC scan mode"
    depends on ANALOG_INPUT
    default n
    help
      Enable ADC scan mode for reading multiple channels in one go.
      This is more efficient but requires hardware support.

config ANALOG_INPUT_LOG_DBG_RAW
    bool "Enable logging of raw and pre-processed values"
    depends on ANALOG_INPUT && LOG
    default n
    help
      Enable detailed logging of raw ADC values and pre-processed values.

config ANALOG_INPUT_LOG_DBG_REPORT
    bool "Enable logging of reported values"
    depends on ANALOG_INPUT && LOG
    default n
    help
      Enable detailed logging of values sent to the input subsystem.
```

## dts/bindings/zmk,analog-input.yaml
```yaml
# Copyright (c) 2022 The ZMK Contributors
# SPDX-License-Identifier: MIT
description: |
  Input driver for ADC io channel with scan mode support

compatible: "zmk,analog-input"

properties:
  sampling-hz:
    type: int
    default: 100
  
  scan-mode:
    type: boolean
    description: |
      Enable ADC scan mode for reading multiple channels.
      Presence of this property enables scan mode.
    required: false  # 设为可选属性，不存在时默认为 false
  
  scan-channels:
    type: array
    description: |
      List of ADC channel IDs to scan (when scan-mode is enabled).
      Each entry corresponds to a channel in the order they will be sampled.
    required: false

child-binding:
  description: Per-channel configuration settings
  properties:
    io-channels:
      type: phandle-array
      required: true
    mv-mid:
      type: int
      required: true
    mv-min-max:
      type: int
      required: true
    mv-deadzone:
      type: int
      default: 10
    invert:
      type: boolean
    report-on-change-only:
      type: boolean
    scale-multiplier:
      type: int
      default: 1
    scale-divisor:
      type: int
      default: 70
    evt-type:
      type: int
      required: true
    input-code:
      type: int
      required: true
```
